## Documentation/devicetree/bindings/mtd/rockchip-sfc.txt
```
Rockchip Serial Flash Controller

Required properties:
- compatible : Should be
		"rockchip,rv1108-sfc", "rockchip,sfc" for ROCKCHIP RV1108.
- address-cells : Should be 1.
- size-cells : Should be 0.
- clocks: Must contain two entries for each entry in clock-names.
- clock-names: Shall be "sfc" for the transfer-clock, and "hsfc" for
		the peripheral clock.
- interrupts : Should contain the interrupt for the device.
- reg: Physical base address of the controller and length of memory mapped.

Optional properties:
- rockchip,sfc-no-dma: Indicate the controller doesn't support DMA transfer.

Example:
nor_flash: sfc@301c0000 {
	compatible = "rockchip,rv1108-sfc", "rockchip,sfc";
	#address-cells = <1>;
	#size-cells = <0>;
	clocks = <&cru SCLK_SFC>, <&cru HCLK_SFC>;
	clock-names = "sfc", "hsfc";
	interrupts = <GIC_SPI 56 IRQ_TYPE_LEVEL_HIGH>;
	reg = <0x301c0000 0x1000>;
	spi-nor@0 {
		compatible = "jedec,spi-nor";
		spi-max-frequency = <12000000>;
		reg = <0>;
	};
};
```
